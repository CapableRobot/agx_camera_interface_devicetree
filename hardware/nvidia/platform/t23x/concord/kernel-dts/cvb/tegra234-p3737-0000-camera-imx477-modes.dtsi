mode0 { /* IMX477_MODE_3840x2160 */
    mclk_khz = "24000";
    num_lanes = "2";
    tegra_sinterface = TEGRA_SINTERFACE;
    phy_mode = "DPHY";
    discontinuous_clk = "no";
    dpcm_enable = "false";
    cil_settletime = "0";

    active_w = "3840";
    active_h = "2160";
    mode_type = "bayer";
    pixel_phase = "rggb";
    csi_pixel_bit_depth = "10";
    line_length = "11200";
    readout_orientation = "90";
    inherent_gain = "1";
    mclk_multiplier = "80";
 
    /* Use two pixel clocks:
     1. One is used to calculate the mipi_clock in the subsystem and match the mipi clock of the sensor
     2. Internal sensor pix_clk of the sensor to calculate fps, and integration */
 
    /* Use this pix clk to get 1.5 gbps per lane inside the camera_common calculations */
    pix_clk_hz = "300000000";
 
    gain_factor = "16";
    framerate_factor = "1000000";
    exposure_factor = "1000000";
    min_gain_val = "16"; /* 1.00x */
    max_gain_val = "356"; /* 22x */
    step_gain_val = "1";
    default_gain = "16"; /* 1.00x */
    min_hdr_ratio = "1";
    max_hdr_ratio = "1";
    min_framerate = "2000000"; /* 2.0 fps */
    max_framerate = "30000000"; /* 30.0 fps */
    step_framerate = "1";
    default_framerate = "30000000"; /* 30.0 fps */
    min_exp_time = "13"; /* us */
    max_exp_time = "683709"; /* us */
    step_exp_time = "1";
    default_exp_time = "2495"; /* us */
 
    embedded_metadata_height = "2";
};
 
mode1 { /* IMX477_MODE_1920X1080 */
    mclk_khz = "24000";
    num_lanes = "2";
    tegra_sinterface = TEGRA_SINTERFACE;
    phy_mode = "DPHY";
    discontinuous_clk = "no";
    dpcm_enable = "false";
    cil_settletime = "0";

    active_w = "1920";
    active_h = "1080";
    mode_type = "bayer";
    pixel_phase = "rggb";
    csi_pixel_bit_depth = "10";
    readout_orientation = "90";
    line_length = "7000";
    inherent_gain = "1";
    mclk_multiplier = "80";

    /* Use two pixel clocks:
     1. One is used to calculate the mipi_clock in the subsystem and match the mipi clock of the sensor,
     2. Internal sensor pix_clk of the sensor to calculate fps, and integration */

    /* Use this pix clk to get 1.5 gbps per lane inside the camera_common calculations */
    pix_clk_hz = "300000000";

    gain_factor = "16";
    framerate_factor = "1000000";
    exposure_factor = "1000000";
    min_gain_val = "16"; /* 1.00x */
    max_gain_val = "356"; /* 22x */
    step_gain_val = "1";
    default_gain = "16"; /* 1.00x */
    min_hdr_ratio = "1";
    max_hdr_ratio = "1";
    min_framerate = "2000000"; /* 2.0 fps */
    max_framerate = "60000000"; /* 60.0 fps */
    step_framerate = "1";
    default_framerate = "60000000"; /* 60.0 fps */
    min_exp_time = "13"; /* us */
    max_exp_time = "683709"; /* us */
    step_exp_time = "1";
    default_exp_time = "2495"; /* us */

    embedded_metadata_height = "2";
};